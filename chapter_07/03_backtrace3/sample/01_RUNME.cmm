B::

PRIVATE &os_ppd

&os_ppd=OS.PresentPracticeDirectory()

DODECRYPT "password" &os_ppd/01_RUNME.emm

ENDDO
